## boards/trik/trik-board/board.yml
```yaml
board:
  name: trik-board
  vendor: Trik
  full_name: Trik Board
  socs:
    - name: nrf52833
```

## boards/trik/trik-board/trik-board_defconfig
```kconfig
CONFIG_ARM_MPU=y
CONFIG_HW_STACK_PROTECTION=y
CONFIG_NRF_RTC_TIMER=y
CONFIG_SYS_CLOCK_EXISTS=y
CONFIG_GPIO=y
CONFIG_CRC=y
CONFIG_CLOCK_CONTROL_NRF_K32SRC_RC=y
CONFIG_SPEED_OPTIMIZATIONS=y
```
